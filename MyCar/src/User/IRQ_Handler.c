/*---------------------------------------------------------------
【注意事项】中断服务函数的名称在startup_MK60D10.s 中
----------------------------------------------------------------*/
#include "include.h"


/////////////////////////////////////////////////////////////////
///////////////PIT中断服务函数///////////////////////////////////
/////////////////////////////////////////////////////////////////
//------------------------------------------------------------------------------------------------    
//全局变量  用于测试PIT定时器
//------------------------------------------------------------------------------------------------ 
extern volatile uint8_t pit0_test_flag;
extern volatile uint8_t pit1_test_flag;
extern volatile uint8_t pit2_test_flag;
extern volatile uint8_t pit3_test_flag;

/*---------------------------------------------------------------
这是一个中断函数
----------------------------------------------------------------*/
void PIT0_IRQHandler()//中断读取当前速度值
{
    PIT_Flag_Clear(PIT0);       //清中断标志位
    LED_Reverse(1);
    Get_speed();
    pit0_test_flag = 1;
}
/*---------------------------------------------------------------
PIT1_Interrupt
----------------------------------------------------------------*/
void PIT1_IRQHandler()
{
    PIT_Flag_Clear(PIT1);       //清中断标志位
    /*用户添加所需代码*/
    pit1_test_flag = 1;
}
/*---------------------------------------------------------------
PIT2_Interrupt
----------------------------------------------------------------*/
void PIT2_IRQHandler()
{
    PIT_Flag_Clear(PIT2);       //清中断标志位
    /*用户添加所需代码*/
    pit2_test_flag = 1;
}
/*---------------------------------------------------------------
PIT3_Interrupt
----------------------------------------------------------------*/
void PIT3_IRQHandler()
{
    PIT_Flag_Clear(PIT3);       //清中断标志位
    /*用户添加所需代码*/
    pit3_test_flag = 1;
}

/////////////////////////////////////////////////////////////////
///////////////串口中断服务函数/////////////////////////////////
/////////////////////////////////////////////////////////////////


//------------------------------------------------------------------------------------------------    
//全局变量  用于测试按键外部中断
//------------------------------------------------------------------------------------------------
extern volatile uint8_t key_exti_flag;
char u4_data[40]={0};//储存传输的数据，并提取
int success_fg=0;//是否传完一次，1 传完，K...A...E的格式，（A是参数之间的隔断标志）等数据传完，最多2.78ms,应该用40*8/115200


/////////////////////////////////////////////////////////////////
///////////////GPIO中断服务函数//////////////////////////////////
/////////////////////////////////////////////////////////////////
/*---------------------------------------------------------------
PORTB_Interrupt
----------------------------------------------------------------*/
void PORTB_IRQHandler()
{
    
    /* 中断使用的引脚号，这里只写了管脚20和管脚21和22，使用其他管脚可以自行添加 */
    int n;  
    n=20;
    if((PORTB_ISFR & (1<<n)))//需要改参数是按下这个按键，然后按复位按键重新初始化pid参数即可
    {
        LED_Reverse(0); 
        Parameter_Init();  
        key_exti_flag = 0;
    } 
    n=21;
    if((PORTB_ISFR & (1<<n)))
    {
        LED_Reverse(2);
        AD_max_min();
        key_exti_flag = 1;
    } 
    n=22;
    if((PORTB_ISFR & (1<<n)))
    {
        /* 用户自行添加中断内程序 */
        key_exti_flag = 2;
    }
    //清除中断标志
    PORTB_ISFR = 0xffffffff;
}
/////////////////////////////////////////////////////////////////
///////////////串口中断服务函数/////////////////////////////////
/////////////////////////////////////////////////////////////////

/*---------------------------------------------------------------
【函    数】DMA_CH4_Handler
【功    能】DMA通道4的中断服务函数
【参    数】无
【返 回 值】无
【注意事项】注意进入后要清除中断标志位
----------------------------------------------------------------*/
void UART4_RX_TX_IRQHandler(void)
{
  char temp_4;
  if(UART4_S1 & UART_S1_RDRF_MASK)                                     //接收数据寄存器满
  {
    temp_4 = UART_GetChar(UART4); 
  }
  if(success_fg==0)//防止多余数据输入，影响正常时序，导致错误
  {         
      for(int i=0;i<40-1; i++)
      {
          u4_data[i]=u4_data[i+1];
      }    
          u4_data[40-1]=temp_4;
   if(temp_4=='E'|| temp_4=='e')
       {success_fg=1;}//传输结束
  }

}